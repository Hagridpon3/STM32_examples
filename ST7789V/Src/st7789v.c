/*
 * st7789v.c
 *
 *  Created on: 9. 4. 2019
 *      Author: daymoon
 */

#include "st7789v.h"
#include "st7789v_commands.h"
#include "main.h"
//#include "delay.h"
//#include "mcuperipherals.h"
#include "interface.h"
#include "string.h"

const uint8_t PRUSAMINI[] = "Original Prusa MINI";
const uint8_t LINE1[] = "Rectangular_elephant_0.15mm_PLA_MK3S.gcode";
const uint8_t LINE2[] = "Colorful_bridge_toy_0.10mm_PET_MK3S.gcode";
const uint8_t LINE3[] = "Can_opener_screwdriver_0.10mm_PLA_MK3S.gcode";
const uint8_t LINE4[] = "Milkbottle_handle_0.15mm_PET_MK3S.gcode";
const uint8_t LINE5[] = "Very_long_model_name_with_some_adjectives_0.15mm_PLA_MK3S.gcode";

const uint16_t ASCII12x12_Table [] = {
    0x0000,0x0000,0x0000,0x0000,0x0000,0x0000,0x0000,0x0000,0x0000,0x0000,0x0000,0x0000,	// space
    0x0000,0x2000,0x2000,0x2000,0x2000,0x2000,0x2000,0x2000,0x0000,0x2000,0x0000,0x0000,	// !
    0x0000,0x5000,0x5000,0x5000,0x0000,0x0000,0x0000,0x0000,0x0000,0x0000,0x0000,0x0000,	// "
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    0x0000,0x0000,0x7000,0x5000,0x5000,0x5000,0x5000,0x5000,0x5000,0x7000,0x0000,0x0000};	//


const uint16_t ASCII8x12_Table [] =
{
    0x00,0x00,0x00,0x00,0x00,0x00,0x00,0x00,0x00,0x00,0x00,0x00,
    0x00,0x00,0x00,0x10,0x10,0x10,0x10,0x10,0x10,0x00,0x10,0x00,
    0x00,0x00,0x00,0x28,0x28,0x28,0x00,0x00,0x00,0x00,0x00,0x00,
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    0x00,0x00,0x00,0x00,0xe0,0xa0,0xa0,0xa0,0xa0,0xa0,0xe0,0x00};

static const uint8_t logo_map[] = {
  0x00, 0x00, 0x00, 0x00, 0x00, 0x00, 0x00, 0x00, 0x00, 0x00, 0x00, 0x00, 0x00, 0x00, 0x00, 0x00, 0x00, 0x00, 0x00, 0x00, 0x00, 0x00, 0x00, 0x00, 0x00, 0x00, 0x00, 0x00, 0x00,
  0x00, 0x00, 0x00, 0x00, 0x00, 0x00, 0x00, 0x00, 0x00, 0x00, 0x00, 0x00, 0x00, 0x00, 0x00, 0x00, 0x00, 0x00, 0x00, 0x00, 0x00, 0x00, 0x00, 0x00, 0x00, 0x00, 0x00, 0x00, 0x00,
  0x00, 0x00, 0x00, 0x00, 0x00, 0x00, 0x00, 0x00, 0x00, 0x00, 0x00, 0x00, 0x00, 0x00, 0x00, 0x00, 0x00, 0x00, 0x00, 0x00, 0x00, 0x00, 0x00, 0x00, 0x00, 0x00, 0x00, 0x00, 0x00,
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  0x00, 0x00, 0x00, 0x00, 0x00, 0x00, 0x00, 0x00, 0x00, 0x00, 0x00, 0x00, 0x00, 0x00, 0x00, 0x00, 0x00, 0x00, 0x00, 0x00, 0x00, 0x00, 0x00, 0x00, 0x00, 0x00, 0x00, 0x00, 0x00,
};

/*
void st7789v_config(void)
{
	// inicializace portu
	GPIO_InitTypeDef  GPIO_InitStructure;

	// SS
	RCC_AHB1PeriphClockCmd(DISPLAY_SS_CLOCK, ENABLE);
	GPIO_InitStructure.GPIO_Pin = DISPLAY_SS;
	GPIO_InitStructure.GPIO_Mode = GPIO_Mode_OUT;
	GPIO_InitStructure.GPIO_OType = GPIO_OType_PP;
	GPIO_InitStructure.GPIO_Speed = GPIO_Speed_2MHz;
	GPIO_InitStructure.GPIO_PuPd = GPIO_PuPd_NOPULL;
	GPIO_Init(DISPLAY_SS_PORT, &GPIO_InitStructure);
	GPIO_SetBits(DISPLAY_SS_PORT, DISPLAY_SS);				// CS high

	// RST
	RCC_AHB1PeriphClockCmd(DISPLAY_RST_CLOCK, ENABLE);
	GPIO_InitStructure.GPIO_Pin = DISPLAY_RST;
	GPIO_InitStructure.GPIO_Mode = GPIO_Mode_OUT;
	GPIO_InitStructure.GPIO_OType = GPIO_OType_PP;
	GPIO_InitStructure.GPIO_Speed = GPIO_Speed_2MHz;
	GPIO_InitStructure.GPIO_PuPd = GPIO_PuPd_NOPULL;
	GPIO_Init(DISPLAY_RST_PORT, &GPIO_InitStructure);
	GPIO_SetBits(DISPLAY_RST_PORT, DISPLAY_RST);			// RST high

	// RS
	RCC_AHB1PeriphClockCmd(DISPLAY_RS_CLOCK, ENABLE);
	GPIO_InitStructure.GPIO_Pin = DISPLAY_RS;
	GPIO_InitStructure.GPIO_Mode = GPIO_Mode_OUT;
	GPIO_InitStructure.GPIO_OType = GPIO_OType_PP;
	GPIO_InitStructure.GPIO_Speed = GPIO_Speed_2MHz;
	GPIO_InitStructure.GPIO_PuPd = GPIO_PuPd_NOPULL;
	GPIO_Init(DISPLAY_RS_PORT, &GPIO_InitStructure);

	//tady to je moje
	RCC_AHB1PeriphClockCmd(OUT_1_CLOCK, ENABLE);
	GPIO_InitStructure.GPIO_Pin = OUT_1_PIN;
	GPIO_InitStructure.GPIO_Mode = GPIO_Mode_OUT;
	GPIO_InitStructure.GPIO_OType = GPIO_OType_PP;
	GPIO_InitStructure.GPIO_Speed = GPIO_Speed_2MHz;
	GPIO_InitStructure.GPIO_PuPd = GPIO_PuPd_NOPULL;
	GPIO_Init(OUT_1_PORT, &GPIO_InitStructure);
	//tady uz ne

	// SPI
	SPI2_Pins_Init();
	SPI2_Fast_Init();
}
*/
void st7789v_testpins(void)
{
	/*
	GPIO_ResetBits(DISPLAY_SS_PORT, DISPLAY_SS);				// CS low
	GPIO_ResetBits(DISPLAY_RS_PORT, DISPLAY_RS);				// RS low
	GPIO_ResetBits(DISPLAY_RST_PORT, DISPLAY_RST);				// RST low

	//delay_ms(1);

	GPIO_SetBits(DISPLAY_SS_PORT, DISPLAY_SS);					// CS high
	GPIO_SetBits(DISPLAY_RS_PORT, DISPLAY_RS);					// RS high
	GPIO_SetBits(DISPLAY_RST_PORT, DISPLAY_RST);				// RST high

	//delay_ms(1);

	GPIO_ResetBits(DISPLAY_SS_PORT, DISPLAY_SS);				// CS low
	GPIO_ResetBits(DISPLAY_RS_PORT, DISPLAY_RS);				// RS low
	GPIO_ResetBits(DISPLAY_RST_PORT, DISPLAY_RST);				// RST low
	*/

	//delay_ms(1);

	uint8_t i;
	//for (i = 0; i < 5; i++)
	while(1)
	{
		send_intruction(0x25);
		send_data(0x38);

		//SPI_I2S_SendData(DISPLAY_SPI, 0x55);

		//GPIO_ResetBits(DISPLAY_SCK_PORT, DISPLAY_SCK);
		//GPIO_ResetBits(DISPLAY_MOSI_PORT, DISPLAY_MOSI);
		//GPIO_SetBits(DISPLAY_SCK_PORT, DISPLAY_SCK);
		//GPIO_SetBits(DISPLAY_MOSI_PORT, DISPLAY_MOSI);
	}
}

void display_init(void)
{
	//st7789v_config();
	//st7789v_testpins();
	st7789v_init();
	//st7789v_display_clear(BACKGROUND);
}

void send_intruction(uint8_t byte)
{
  CS_low();
  RS_instruction(); // RS = L
  SPI2_Write(byte);
  CS_high();
}

void send_data(uint8_t byte)
{
  CS_low();
  RS_data(); 	// RS = H
  SPI2_Write(byte);
  CS_high();
}

void CS_low(void)
{
	//digitalWrite(DISPLAY_SS, LOW);
	//GPIO_ResetBits(DISPLAY_SS_PORT, DISPLAY_SS);				// CS low
	HAL_GPIO_WritePin(GPIOG, GPIO_PIN_10, 0);
}

void CS_high(void)
{
	/* Loop while DR register in not empty */
	//while(SPI_I2S_GetFlagStatus(DISPLAY_SPI, SPI_I2S_FLAG_TXE) == RESET);

	//digitalWrite(DISPLAY_SS, HIGH);
	//GPIO_SetBits(DISPLAY_SS_PORT, DISPLAY_SS);				// CS high
	HAL_GPIO_WritePin(GPIOG, GPIO_PIN_10, 1);
}

void RS_instruction(void)
{
  //digitalWrite(DISPLAY_RS, LOW);
  //GPIO_ResetBits(DISPLAY_RS_PORT, DISPLAY_RS);				// RS low
  HAL_GPIO_WritePin(GPIOC, GPIO_PIN_7, 0);
}

void RS_data(void)
{
  //digitalWrite(DISPLAY_RS, HIGH);
  //GPIO_SetBits(DISPLAY_RS_PORT, DISPLAY_RS);				// RS high
  HAL_GPIO_WritePin(GPIOC, GPIO_PIN_7, 1);
}

void RST_active(void)
{
  //digitalWrite(DISPLAY_RST, LOW);
  //GPIO_ResetBits(DISPLAY_RST_PORT, DISPLAY_RST);			// RST low
  HAL_GPIO_WritePin(GPIOC, GPIO_PIN_6, 0);
}

void RST_deactive(void)
{
  //digitalWrite(DISPLAY_RST, HIGH);
  //GPIO_SetBits(DISPLAY_RST_PORT, DISPLAY_RST);				// RST high
  HAL_GPIO_WritePin(GPIOC, GPIO_PIN_6, 1);
}

void st7789v_init(void)
{
	// reset displeje
	RST_active();                     // aktivace resetu
	//delay(10);
	delay_ms(15);
	RST_deactive();                   // deaktivace resetu
	//delay(120);                       // pauza po resetu
	delay_ms(120);

	send_intruction(SLPOUT);          // opusteni rezimu spanku
	//delay(120);                       // pauza po spanku
	delay_ms(120);

	// inicializace zakladni
	send_intruction(MADCTL);          // nastaveni adres a zrcadleni
	send_data(0xC0);                  // vychozi hodnota MADCTL

	send_intruction(COLMOD);          // nastaveni barevneho rozsahu
	send_data(0x05);                  // 5-6-5 barvy

	send_intruction(DISPON);          // zapnuti displeje
	//delay(10);                       // pauza po DISPON
	delay_ms(10);
}

void st7789v_display_clear(uint16_t color)
{
  uint32_t pixel;

  st7789v_set_cursor(0,0);

  send_intruction(RAMWR);           // zapis pixelu
  CS_low();
  RS_data(); // RS = H
  for (pixel = 0; pixel < 153600; pixel++)
  {
    //SPI.transfer((color>>8) & 0xFF);
    SPI2_Write((color>>8) & 0xFF);
    //SPI.transfer(color & 0xFF);
    SPI2_Write(color & 0xFF);
    //delay(1);
  }
  CS_high();
}

void st7789v_window_clear(uint16_t startx, uint16_t endx, uint16_t starty, uint16_t endy, uint16_t color)
{
	uint16_t x,y;

	for (y = starty; y < endy; y++)
	{
		st7789v_set_cursor(startx, y);
		send_intruction(RAMWR);           // zapis pixelu
		CS_low();
		RS_data(); // RS = H
		for (x = startx; x < endx; x++)
		{
			SPI2_Write((color>>8) & 0xFF);
			SPI2_Write(color & 0xFF);
		}
		CS_high();
	}
}

void st7789v_set_cursor(uint8_t xpos, uint16_t ypos)
{
  send_intruction(CASET);           // nastaveni adresy sloupce
  send_data(0x00);                  // CASET byte 0
  send_data(xpos);                  // CASET byte 1
  send_data(0x00);                  // CASET byte 2
  send_data(0xEF);                  // CASET byte 3

  send_intruction(RASET);           // nastaveni adresy radku
  send_data((ypos >> 8) & 0xFF);    // RASET byte 0
  send_data(ypos & 0xFF);           // RASET byte 1
  send_data(0x01);                  // RASET byte 2
  send_data(0x3F);                  // RASET byte 3
}

void duha(void)
{
  uint8_t i;
  uint16_t y;
  uint8_t state = 0;
  uint8_t green = 0;
  uint8_t red = 0;
  uint8_t blue = 0;
  uint16_t colour;

  st7789v_display_clear(BACKGROUND);        // vymaz displej

  for (y = 0; y < DISPYSIZE; y++)
  {

	st7789v_set_cursor(0,y);                  // kurzor pro vykresleni duhy
    send_intruction(RAMWR);           // zapis pixelu
    CS_low();
    RS_data(); // RS = H

     switch (state) {
      case 0:
        green++;
        if (green == 64) {
          green = 63;
          state = 1;
        }
        break;
      case 1:
        red--;
        if (red == 255) {
          red = 0;
          state = 2;
        }
        break;
      case 2:
        blue++;
        if (blue == 32) {
          blue = 31;
          state = 3;
        }
        break;
      case 3:
        green--;
        if (green == 255) {
          green = 0;
          state = 4;
        }
        break;
      case 4:
        red ++;
        if (red == 32) {
          red = 31;
          state = 5;
        }
        break;
      case 5:
        blue --;
        if (blue == 255) {
          blue = 0;
          state = 0;
        }
        break;
    }
    colour = red << 11 | green << 5 | blue;

    /*for (i = 0; i < FLIRLENGTH; i++)
    {
      SPI.transfer((~FLIR_rainbow[i]>>8) & 0xFF);
      SPI.transfer(~FLIR_rainbow[i] & 0xFF);
    }
    CS_high();
    */
    // vykresleni radku
    for (i = 0; i < DISPXSIZE; i++)
    {
    	SPI2_Write((colour>>8) & 0xFF);
    	SPI2_Write(colour & 0xFF);
    }
    CS_high();
  }
}

void black_line(void)
{
  uint32_t i;
  uint16_t y;
  uint16_t colour;

  uint8_t line[DISPXSIZE * 2];

  //st7789v_display_clear(BACKGROUND);        // vymaz displej

  //uint32_t cnt = DISPYSIZE * DISPXSIZE;

  //st7789v_set_cursor(0,y);                  // kurzor pro vykresleni duhy
  send_intruction(RAMWR);           // zapis pixelu
  CS_low();
  RS_data(); // RS = H

    colour = BLACK;

	for (i = 0; i < DISPXSIZE; i++)
	{
		line[2 * i + 0] = ((colour>>8) & 0xFF);
		line[2 * i + 1] = (colour & 0xFF);
	}

    // vykresleni radku
    for (i = 0; i < DISPYSIZE; i++)
    {
    	//SPI2_Write((colour>>8) & 0xFF);
    	//SPI2_Write(colour & 0xFF);
    	SPI2_Write_line(line,DISPXSIZE*2);
    }

    CS_high();
}

void white_line(void)
{
  uint32_t i;
  uint16_t y;
  uint16_t colour;

  uint8_t line[DISPXSIZE * 2];

  //st7789v_display_clear(BACKGROUND);        // vymaz displej

  //uint32_t cnt = DISPYSIZE * DISPXSIZE;

  //st7789v_set_cursor(0,y);                  // kurzor pro vykresleni duhy
  send_intruction(RAMWR);           // zapis pixelu
  CS_low();
  RS_data(); // RS = H

    colour = WHITE;

	for (i = 0; i < DISPXSIZE; i++)
	{
		line[2 * i + 0] = ((colour>>8) & 0xFF);
		line[2 * i + 1] = (colour & 0xFF);
	}

    // vykresleni radku
    for (i = 0; i < DISPYSIZE; i++)
    {
    	//SPI2_Write((colour>>8) & 0xFF);
    	//SPI2_Write(colour & 0xFF);
    	SPI2_Write_line(line,DISPXSIZE*2);
    }

    CS_high();
}

void white(void)
{
  uint32_t i;
  uint16_t y;
  uint16_t colour;

  //st7789v_display_clear(BACKGROUND);        // vymaz displej

  uint32_t cnt = DISPYSIZE * DISPXSIZE;

  st7789v_set_cursor(0,y);                  // kurzor pro vykresleni duhy
  send_intruction(RAMWR);           // zapis pixelu
  CS_low();
  RS_data(); // RS = H

    colour = WHITE;

    // vykresleni radku
    for (i = 0; i < cnt; i++)
    {
    	SPI2_Write((colour>>8) & 0xFF);
    	SPI2_Write(colour & 0xFF);
    }

    CS_high();
}

void black(void)
{
  uint32_t i;
  uint16_t y;
  uint16_t colour;

  st7789v_display_clear(BACKGROUND);        // vymaz displej

  uint32_t cnt = DISPYSIZE * DISPXSIZE;

  //st7789v_set_cursor(0,y);                  // kurzor pro vykresleni duhy
  send_intruction(RAMWR);           // zapis pixelu
  CS_low();
  RS_data(); // RS = H

    colour = BLACK;

    // vykresleni radku
    for (i = 0; i < cnt; i++)
    {
    	SPI2_Write((colour>>8) & 0xFF);
    	SPI2_Write(colour & 0xFF);
    }

    CS_high();
}

void print_char(uint8_t character, uint8_t xpos, uint16_t ypos, uint16_t color, uint8_t inv)
{
  uint8_t line;
  uint16_t input;
  uint8_t bitpos;
  uint8_t xposlimit;

  for (line = 0; line < CHARHEIGHT; line++)
  {

    st7789v_set_cursor(xpos,ypos+line);        // novy mikroradek pro vykresleni znaku
    xposlimit = xpos;

    input = ASCII12x12_Table[CHARHEIGHT*(character-' ')+line];
    send_intruction(RAMWR);           // zapis pixelu
    CS_low();
    RS_data(); // RS = H

    for (bitpos = 0; bitpos < CHARWIDTH; bitpos++)	// bylo 8 misto CHARWIDTH
    {// pro kazdy bit zleva doprava

      if (xposlimit++ < DISPXSIZE)
      {
        if (input & (0x8000 >> bitpos))
        {
          // bit je jednicka
          if (inv == NOINV)
          {
            // primy rezim
        	  SPI2_Write((color>>8) & 0xFF);
        	  SPI2_Write(color & 0xFF);
          }
          else
          {
            // inverzni rezim
        	  SPI2_Write((BACKGROUND>>8) & 0xFF);
        	  SPI2_Write(BACKGROUND & 0xFF);
          }
        }
        else
        {
          // bit je nula
        	SPI2_Write((BACKGROUND>>8) & 0xFF);
        	SPI2_Write(BACKGROUND & 0xFF);
        }
      }
    }
    CS_high();
  }
}

void text_print(uint8_t x, uint16_t y, uint8_t *text, uint16_t color, uint8_t mode, uint16_t maxwidth)
{
  uint8_t i, length;

  // pro celou delku retezce nebo maximalni sirku okna vypis text po znacich
  if (CHARWIDTH*strlen((const char*)text) > maxwidth)
  {
	  length = maxwidth / CHARWIDTH;
  }
  else
  {
	  length = strlen((const char*)text);
  }
  for (i = 0; i < length; i++)
  {
    if (x+i*CHARWIDTH < DISPXSIZE)
    {
      print_char(text[i], x+i*CHARWIDTH, y, color, mode);
    }
  }
}

void logo(uint8_t color)
{
  uint8_t i;
  uint16_t index;
  uint8_t ypos;
  uint8_t xpos;
  uint16_t logopointer;
  uint8_t logobyte;

  // logo width 29 bytes
  // logo heigth 157 bytes
  logopointer = 0;
  for (ypos = 0; ypos < 157; ypos++)
  {
    st7789v_set_cursor(4, 159+ypos);

    send_intruction(RAMWR);
    CS_low();
    RS_data(); // RS = H

    for (xpos = 0; xpos < 29; xpos++)
    {
      logobyte = logo_map[logopointer++];

      for (i = 0; i < 8; i++)
      {// pro kazdy bit zleva doprava
        if (logobyte & (0x80 >> i))
        {
          // bit je jednicka
        	SPI2_Write((color>>8) & 0xFF);
        	SPI2_Write(color & 0xFF);
        }
        else
        {
          // bit je nula
        	SPI2_Write((BACKGROUND>>8) & 0xFF);
        	SPI2_Write(BACKGROUND & 0xFF);
        }
      }
    }
    CS_high();
  }
}



